## components/si4432/Kconfig.projbuild
```kconfig
menu "SI4432 Configuration"

	config GPIO_RANGE_MAX
		int
		default 33 if IDF_TARGET_ESP32
		default 46 if IDF_TARGET_ESP32S2
		default 48 if IDF_TARGET_ESP32S3
		default 18 if IDF_TARGET_ESP32C2
		default 19 if IDF_TARGET_ESP32C3

	config MISO_GPIO
		int "SI4432 MISO GPIO"
		range 0 GPIO_RANGE_MAX
		default 19 if IDF_TARGET_ESP32
		default 37 if IDF_TARGET_ESP32S2 || IDF_TARGET_ESP32S3
		default  4 if IDF_TARGET_ESP32C3 || IDF_TARGET_ESP32C2
		help
			Pin Number to be used as the MISO SPI signal.

	config SCK_GPIO
		int "SI4432 SCK GPIO"
		range 0 GPIO_RANGE_MAX
		default 18 if IDF_TARGET_ESP32
		default 36 if IDF_TARGET_ESP32S2 || IDF_TARGET_ESP32S3
		default  3 if IDF_TARGET_ESP32C3 || IDF_TARGET_ESP32C2
		help
			Pin Number to be used as the SCK SPI signal.

	config MOSI_GPIO
		int "SI4432 MOSI GPIO"
		range 0 GPIO_RANGE_MAX
		default 23 if IDF_TARGET_ESP32
		default 35 if IDF_TARGET_ESP32S2 || IDF_TARGET_ESP32S3
		default  2 if IDF_TARGET_ESP32C3 || IDF_TARGET_ESP32C2
		help
			Pin Number to be used as the MOSI SPI signal.

	config SEL_GPIO
		int "SI4432 SEL GPIO"
		range 0 GPIO_RANGE_MAX
		default  5 if IDF_TARGET_ESP32
		default 34 if IDF_TARGET_ESP32S2 || IDF_TARGET_ESP32S3
		default  1 if IDF_TARGET_ESP32C3 || IDF_TARGET_ESP32C2
		help
			Pin Number to be used as the SEL SPI signal.

	config SDN_GPIO
		int "SI4432 SDN GPIO"
		range 0 GPIO_RANGE_MAX
		default 15 if IDF_TARGET_ESP32
		default 40 if IDF_TARGET_ESP32S2 || IDF_TARGET_ESP32S3
		default  5 if IDF_TARGET_ESP32C3 || IDF_TARGET_ESP32C2
		help
			Pin Number to be used as the SDN signal.

	config IRQ_GPIO
		int "SI4432 IRQ GPIO"
		range 0 GPIO_RANGE_MAX
		default 16 if IDF_TARGET_ESP32
		default 41 if IDF_TARGET_ESP32S2 || IDF_TARGET_ESP32S3
		default  6 if IDF_TARGET_ESP32C3 || IDF_TARGET_ESP32C2
		help
			Pin Number to be used as the IRQ signal.

	choice SPI_HOST
		prompt "SPI peripheral that controls this bus"
		default SPI2_HOST
		help
			Select SPI peripheral that controls this bus.
		config SPI2_HOST
			bool "SPI2_HOST"
			help
				Use SPI2_HOST. This is also called HSPI_HOST.
		config SPI3_HOST
			depends on IDF_TARGET_ESP32 || IDF_TARGET_ESP32S2 || IDF_TARGET_ESP32S3
			bool "SPI3_HOST"
			help
				USE SPI3_HOST. This is also called VSPI_HOST
	endchoice

	config SI4432_CHANNEL
		int "SI4432 channel"
		range 0 255
		default 0
		help
			Both receiver and transmitter must operate on the same channel

	choice
		prompt "SI4432 Frequency"
		default SI4432_FREQ_433
		help
				Select ISM band frequency

		config SI4432_FREQ_433
				bool "433 MHz" 
		config SI4432_FREQ_470
				bool "470 MHz" 
		config SI4432_FREQ_868
				bool "868 MHz" 
		config SI4432_FREQ_915
				bool "915 MHz" 
	endchoice


endmenu
```
